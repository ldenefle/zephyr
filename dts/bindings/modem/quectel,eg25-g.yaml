## dts/bindings/modem/quectel,eg25-g.yaml
```yaml
# Copyright (c) 2020 Analog Life LLC
# SPDX-License-Identifier: Apache-2.0

description: quectel eg25-g modem

compatible: "quectel,eg25-g"

include: uart-device.yaml

properties:
    mdm-reset-gpios:
      type: phandle-array
      required: true

    mdm-dtr-gpios:
      type: phandle-array
      required: true

    mdm-wdisable-gpios:
      type: phandle-array
      required: true

    mdm-reset-pulse-duration:
      type: int
      const: 150
```
